## zmk-config/boards/arm/akdk_bt1/Kconfig.board
```kconfig
# SPDX-License-Identifier: MIT

config BOARD_AKDK_BT1
	bool "akdk_bt1"
	depends on SOC_NRF52840_QIAA
```

## zmk-config/boards/arm/akdk_bt1/Kconfig.defconfig
```kconfig
if BOARD_AKDK_BT1

if USB_DEVICE_STACK

config USB_NRFX
    default y

endif # USB_DEVICE_STACK

config BT_CTLR
    default BT

endif
```
